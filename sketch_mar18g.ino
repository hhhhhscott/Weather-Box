#include <ESP8266WiFi.h>
#include <ESP8266_Seniverse.h>
#include <U8g2lib.h>
//#include <SPI.h>
#include <NTPClient.h>
#include <WiFiUdp.h>
#include <WiFiManager.h>



// Check https://github.com/olikraus/u8g2/wiki/u8g2setupcpp for all supported devices
#define rst  4
#define rsd  5
U8G2_SSD1306_128X64_NONAME_F_SW_I2C  u8g2(U8G2_R0 , rsd ,rst);
//U8G2_SSD1306_128X64_NONAME_F_4W_SW_SPI u8g2(U8G2_R0, /* clock=*/ 4, /* data=*/ 5, /* cs=*/ 3, /* dc=*/ 6, /* reset=*/ 7);

//U8G2_SSD1306_128X64_NONAME_F_4W_SW_SPI u8g2(U8G2_R0, /* clock=*/ 13, /* data=*/ 11, /* cs=*/ 10, /* dc=*/ 9, /* reset=*/ 8);
const String weathers[] = {"晴", "晴", "晴", "晴", "多云", "晴间多云", "晴间多云", "大部多云", "大部多云", "阴",
                           "阵雨", "雷阵雨", "雷雨冰雹", "小雨", "中雨", "大雨", "暴雨", "大暴雨", "特大暴雨",
                           "冻雨", "雨夹雪", "阵雪", "小雪", "中雪", "大雪", "暴雪", "浮尘", "扬沙", "沙尘暴",
                           "强沙暴", "雾", "霾", "风", "大风", "飓风", "热带风暴", "龙卷风", "冷", "热", "未知"
                          };

const unsigned char mi[] U8X8_PROGMEM = {
0x00,0x00,0xFC,0xFF,0x00,0x00,0x00,0x00,0x80,0xFF,0xFF,0x07,0x00,0x00,0x00,0xE0,0x27,0x8B,0x1F,0x00,0x00,0x00,0xF0,0x6C,0x6B,0x3C,0x00,0x00,0x00,0x3C,0x6C,0x6F,
0xF3,0x00,0x00,0x00,0x4E,0x6C,0x6D,0xCB,0x01,0x00,0x00,0xC7,0x78,0x6D,0xAD,0x03,0x00,0x80,0x81,0x38,0x69,0x77,0x07,0x00,0xC0,0x9C,0xE1,0x1F,0xF3,0x0E,0x00,0x60,
0xFC,0xFD,0xFF,0xF8,0x1C,0x00,0x70,0x78,0x1F,0xE3,0x1B,0x3A,0x00,0xB0,0x98,0xC3,0x07,0xB7,0x37,0x00,0x98,0xF8,0xC0,0x0C,0xCE,0x6D,0x00,0xFC,0x7F,0x60,0x18,0xD8,
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0x00,0x00,0x00,0xF0,0xC0,0x0C,0x3C,0x00,0x00,0x00,0xE0,0x27,0x88,0x1F,0x00,0x00,0x00,0x80,0xFF,0xFF,0x07,0x00,0x00,0x00,0x00,0xFC,0xFF,0x00,0x00,0x00
};

String reqUserKey = "SftI0ob8k-q1l1B_-";// 私钥
String reqLocation = "tianjin";// 城市
String reqUnit = "c";// 摄氏/华氏

WeatherNow weatherNow;
Forecast forecast;
WiFiUDP ntpUDP;
NTPClient timeClient(ntpUDP, "ntp1.aliyun.com", 60 * 60 * 8, 30 * 60 * 1000);

int times = 0;

const char* ssid     = "NKU_WLAN";       // 连接WiFi名（此处使用taichi-maker为示例）
                                            // 请将您需要连接的WiFi名填入引号中
const char* password = "";          // 连接WiFi密码（此处使用12345678为示例）
                                            // 请将您需要连接的WiFi密码填入引号中
// Set your new MAC Address
uint8_t newMACAddress[] = {0x7c, 0xa1, 0x77, 0x79, 0x16, 0x5f};
//B4-D5-BD-FB-A7-C5
void setup(){
  Serial.begin(9600);
  Serial.println();
  
  WiFi.mode(WIFI_STA);
  WiFi.softAP("SD", "sd168888");
  
  Serial.print("[OLD] ESP8266 Board MAC Address:  ");
  Serial.println(WiFi.macAddress());

  // For Soft Access Point (AP) Mode
  //wifi_set_macaddr(SOFTAP_IF, &newMACAddress[0]);
  // For Station Mode
  wifi_set_macaddr(STATION_IF, &newMACAddress[0]);
  
  Serial.print("[NEW] ESP8266 Board MAC Address:  ");
  Serial.println(WiFi.macAddress());
    u8g2.begin();
  u8g2.enableUTF8Print();
  u8g2.clearBuffer();
  u8g2.drawXBMP( 39 , 0 , 50 , 50, mi );
  u8g2.setFont(u8g2_font_wqy12_t_gb2312);
  u8g2.setCursor(20, 60);
  u8g2.print("多隆电子协会制");
  u8g2.sendBuffer();
  delay(850);

  connectWiFi();// 连接wifi
  // 配置心知天气请求信息
  weatherNow.config(reqUserKey, reqLocation, reqUnit);
  forecast.config(reqUserKey, reqLocation, reqUnit);
  timeClient.begin();

}
 
void loop(){
u8g2.clearBuffer();// 清空显示设备内部缓冲区
  u8g2.setFont(u8g2_font_wqy12_t_gb2312);

  //天气
  if (weatherNow.update() && forecast.update()) { // 更新天气信息

    //今天的天气、温度
    u8g2.setCursor(43, 12);
    String str1 = weathers[weatherNow.getWeatherCode()] + " " + weatherNow.getDegree() + "℃(今天)";
    u8g2.print(str1);

    //明天的天气、温度范围
    u8g2.setCursor(43, 27);
    str1 = weathers[forecast.getDayCode(1)] + " " + forecast.getLow(1) + "-" + forecast.getHigh(1) + "℃";
    u8g2.print(str1);

    //后天的天气、温度范围
    u8g2.setCursor(43, 42);
    str1 = weathers[forecast.getDayCode(2)] + " " + forecast.getLow(2) + "-" + forecast.getHigh(2) + "℃";
    u8g2.print(str1);

  } else {// 更新失败
    //u8g2.setCursor(53, 61);
    //u8g2.print(">_<...网络慢");
  }

  //时间
  u8g2.setFont(u8g2_font_wqy16_t_gb2312);
  if (timeClient.update()) {
    u8g2.setCursor(53, 61);
    String time = timeClient.getFormattedTime().substring(0, 5);
    u8g2.print(time);
  } else {
    //u8g2.setCursor(53, 61);
    //u8g2.print(">_<...网络慢");
  }

  u8g2.setFont(u8g2_font_unifont_t_symbols);   //先设置字体字集
  if (times == 0) {
    u8g2.drawGlyph(13, 18, 0x2603);
    u8g2.drawGlyph(13, 38, 0x2615);
    u8g2.drawGlyph(15, 58, 0x2600);
    times = 1;
  } else if (times == 1) {
    u8g2.drawGlyph(13, 18, 0x23f0);
    u8g2.drawGlyph(13, 38, 0x23f3);
    u8g2.drawGlyph(15, 58, 0x2614);
    times = 2;
  } else {
    u8g2.drawGlyph(13, 18, 0x2618);
    u8g2.drawGlyph(13, 38, 0x2619);
    u8g2.drawGlyph(15, 58, 0x2606);
    times = 0;
  }

  u8g2.sendBuffer();// 显示缓冲区内容
  delay(10000);
}

void connectWiFi(){
  WiFi.begin(ssid, password);                  // 启动网络连接
  Serial.print("Connecting to ");              // 串口监视器输出网络连接信息
  Serial.print(ssid); Serial.println(" ...");  // 告知用户NodeMCU正在尝试WiFi连接
  
  int i = 0;                                   // 这一段程序语句用于检查WiFi是否连接成功
  while (WiFi.status() != WL_CONNECTED) {      // WiFi.status()函数的返回值是由NodeMCU的WiFi连接状态所决定的。 
    delay(1000);                               // 如果WiFi连接成功则返回值为WL_CONNECTED                       
    Serial.print(i++); Serial.print(' ');      // 此处通过While循环让NodeMCU每隔一秒钟检查一次WiFi.status()函数返回值
  }                                            // 同时NodeMCU将通过串口监视器输出连接时长读秒。
                                               // 这个读秒是通过变量i每隔一秒自加1来实现的。                                              
  Serial.println("");                          // WiFi连接成功后
  Serial.println("Connection established!");   // NodeMCU将通过串口监视器输出"连接成功"信息。
  Serial.print("IP address:    ");             // 同时还将输出NodeMCU的IP地址。这一功能是通过调用
  Serial.println(WiFi.localIP());              // WiFi.localIP()函数来实现的。该函数的返回值即NodeMCU的IP地址。  
}
